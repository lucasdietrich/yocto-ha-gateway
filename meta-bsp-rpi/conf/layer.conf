## meta-bsp-rpi/conf/layer.conf
```bitbake
# We have a conf and classes directory, add to BBPATH
BBPATH .= ":${LAYERDIR}"

# We have recipes-* directories, add to BBFILES
BBFILES += "${LAYERDIR}/recipes-*/*/*.bb \
            ${LAYERDIR}/recipes-*/*/*.bbappend"

BBFILE_COLLECTIONS += "meta-bsp-rpi"
BBFILE_PATTERN_meta-bsp-rpi = "^${LAYERDIR}/"
# meta-raspberrypi priority is 9, so we set this to 10
BBFILE_PRIORITY_meta-bsp-rpi = "10"

LAYERDEPENDS_meta-bsp-rpi = "core raspberrypi"
LAYERSERIES_COMPAT_meta-bsp-rpi = "scarthgap"

# Default machine
MACHINE ??= "rpi3ha-64"

# Default to Release build
HA_DEBUG_IMAGE ?= '0'
```

## meta-bsp-rpi/conf/machine/rpi4ha.conf
```bitbake
require conf/machine/raspberrypi4-64.conf

DISABLE_VC4GRAPHICS="1"
MACHINE_FEATURES:remove="screen"
MACHINE_FEATURES:remove="touchscreen"
MACHINE_FEATURES:remove="vc4graphics"
MACHINE_FEATURES:remove="alsa"
# MACHINE_FEATURES:remove="wifi"

RPI_USE_U_BOOT="1"
ENABLE_SPI_BUS = "1"
ENABLE_CAN = "1"
# ENABLE_DUAL_CAN = "1"
ENABLE_UART = "1"
```

## meta-bsp-rpi/wic/sdimage-ha-raspberrypi.wks
```
# short-description: Create Raspberry Pi SD card image
# long-description: Creates a partitioned SD card image for use with
# Raspberry Pi. Boot files are located in the first vfat partition.

# raspberry pi 1, 2, 3 seems to not support GPT, so we use MBR
# bootloader --ptable gpt

part /boot --source bootimg-partition --ondisk mmcblk0 --fstype=vfat --label boot --active --align 4096 --size 100
part / --source rootfs --ondisk mmcblk0 --fstype=ext4 --label root --align 4096 --fixed-size 512M
part --ondisk mmcblk0 --fstype=ext4 --label root2 --align 4096 --fixed-size 512M
```

## meta-gateway/conf/distro/ha-systemd.conf
```bitbake
require conf/distro/poky.conf

DISTRO = "ha"
DISTRO_VERSION = "1.0"
DISTRO_NAME = "HA distribution"

DISTRO_FEATURES += "systemd"
DISTRO_EXTRA_RDEPENDS += ""
DISTRO_EXTRA_RRECOMMENDS += ""

DISTRO_FEATURES:append = " virtualization"
DISTRO_FEATURES:append = " virtualization"

INIT_MANAGER ?= "sysvinit"

# TCLIB same as poky
```

## meta-gateway/conf/distro/ha.conf
```bitbake
require conf/distro/poky.conf

DISTRO = "ha"
DISTRO_VERSION = "1.0"
DISTRO_NAME = "HA distribution"

PACKAGE_CLASSES = "package_ipk"

DISTRO_FEATURES += "sysvinit"
DISTRO_EXTRA_RDEPENDS += ""
DISTRO_EXTRA_RRECOMMENDS += ""

DISTRO_FEATURES:append = " virtualization"
DISTRO_FEATURES:append = " swap-partition"

# TCLIB same as poky
```
